## Documentation/devicetree/bindings/arm/bcm/brcm,cygnus-pm.txt
```
Broadcom Cygnus Power Management device tree bindings

Cygnus power management support allows for system entering and exiting
power savings states. Power management is enabled by a low-power
co-processor dedicated to Power Management.

Required SoC Specific Properties:
- compatible: should be "brcm,cygnus-pm"

Optional SoC Specific Properties:
- aon_regulators: A sub-root node containing child aon_regulator nodes
  describing AON regulators, which need to be externally disabled while in
  certain PM states
- aon_regulators node has the following properties:
	- Required properties
		- gpio: gpio to use for enable control
	- Optional properties:
		- startup-delay-us: startup time in microseconds
		  If this property is missing, the default assumed is 0.
		- enable-active-high: Polarity of GPIO is Active high
		  If this property is missing, the default assumed is Active low
		- regulator-state-standby sub-root node for Standby
		  (Cygnus sleep) mode
		  : standby, the device is in a power-saving state, but can also
		  receive certain events, specific behavior depends on the
		  specific device.
		- regulator-state-mem sub-root node for Suspend-to-RAM
		  (Cygnus deepsleep) mode
		  : suspend to memory, the device goes to sleep, but all data
		  stored in memory, only some external interrupt can wake the
		  device.
		- regulator-state-mem sub-root node for Cygnus OFF mode
		  : poweroff, the core part of the device is powered off, only
		  some external interrupt can wake the PM co-processor;
		  the device goes through a full boot on wakeup.
		  If this node is missing, regulator state is not modified upon
		  entering and exiting the corresponding PM state.
		- regulator-state-[standby/mem/off] node has the following
		  common properties:
			- regulator-external-off-in-suspend: regulator should be
			  disabled by a PM co-processor while in the
			  corresponding PM state.
			  If this property is missing, regulator state is not
			  modified upon entering and exiting a PM state.

Example:

/ {
	cygnus-pm {
		compatible = "brcm,cygnus-pm";

		aon_regulators {
			a_regulator {
				gpio = <&gpio_x 1 0>;
				startup-delay-us = <50000>;
				enable-active-high;
				regulator-state-mem {
					regulator-external-off-in-suspend;
				};
				regulator-state-off {
					regulator-external-off-in-suspend;
				};
			};
			b_regulator {
				gpio = <&gpio_x 4 0>;
				regulator-state-off {
					regulator-external-off-in-suspend;
				};
			};
		};

	};
};
```

## arch/arm/configs/mustang_defconfig
```kconfig
# CONFIG_LOCALVERSION_AUTO is not set
# CONFIG_SWAP is not set
CONFIG_SYSVIPC=y
CONFIG_NO_HZ=y
CONFIG_HIGH_RES_TIMERS=y
CONFIG_BSD_PROCESS_ACCT=y
CONFIG_BSD_PROCESS_ACCT_V3=y
CONFIG_IKCONFIG=y
CONFIG_IKCONFIG_PROC=y
CONFIG_LOG_BUF_SHIFT=19
CONFIG_CGROUPS=y
CONFIG_CGROUP_FREEZER=y
CONFIG_CGROUP_DEVICE=y
CONFIG_CGROUP_CPUACCT=y
CONFIG_CGROUP_SCHED=y
CONFIG_BLK_CGROUP=y
CONFIG_NAMESPACES=y
CONFIG_BLK_DEV_INITRD=y
CONFIG_SYSCTL_SYSCALL=y
CONFIG_EMBEDDED=y
# CONFIG_COMPAT_BRK is not set
CONFIG_MODULES=y
CONFIG_MODULE_UNLOAD=y
# CONFIG_BLK_DEV_BSG is not set
CONFIG_PARTITION_ADVANCED=y
CONFIG_ARCH_BCM=y
CONFIG_ARCH_BCM_CYGNUS=y
CONFIG_ARM_THUMBEE=y
CONFIG_ARM_ERRATA_754322=y
CONFIG_ARM_ERRATA_764369=y
CONFIG_ARM_ERRATA_775420=y
CONFIG_PCI=y
CONFIG_PCI_MSI=y
CONFIG_PCIEPORTBUS=y
CONFIG_SMP=y
CONFIG_HAVE_ARM_ARCH_TIMER=y
CONFIG_PREEMPT=y
CONFIG_AEABI=y
# CONFIG_COMPACTION is not set
CONFIG_ZBOOT_ROM_TEXT=0x0
CONFIG_ZBOOT_ROM_BSS=0x0
CONFIG_CMDLINE="console=ttyS0,115200n8 mem=128M"
CONFIG_CPU_IDLE=y
CONFIG_VFP=y
CONFIG_NEON=y
# CONFIG_CORE_DUMP_DEFAULT_ELF_HEADERS is not set
CONFIG_NET=y
CONFIG_PACKET=y
CONFIG_PACKET_DIAG=y
CONFIG_UNIX=y
CONFIG_UNIX_DIAG=y
CONFIG_NET_KEY=y
CONFIG_INET=y
CONFIG_IP_MULTICAST=y
CONFIG_IP_PNP=y
CONFIG_IP_PNP_DHCP=y
CONFIG_SYN_COOKIES=y
CONFIG_TCP_MD5SIG=y
CONFIG_BT=y
CONFIG_BT_RFCOMM=y
CONFIG_BT_RFCOMM_TTY=y
# CONFIG_BT_DEBUGFS is not set
CONFIG_BT_HCIUART=m
CONFIG_BT_HCIUART_H4=y
CONFIG_CFG80211=m
CONFIG_CFG80211_DEBUGFS=y
CONFIG_CFG80211_WEXT=y
CONFIG_MAC80211=m
CONFIG_MAC80211_DEBUGFS=y
CONFIG_RFKILL=y
CONFIG_DEVTMPFS=y
CONFIG_DEVTMPFS_MOUNT=y
CONFIG_MTD=y
CONFIG_MTD_CMDLINE_PARTS=y
# CONFIG_MTD_OF_PARTS is not set
CONFIG_MTD_NAND=y
CONFIG_MTD_NAND_BRCMNAND=y
CONFIG_MTD_UBI=y
# CONFIG_BLK_DEV is not set
CONFIG_BCM_RFKILL=y
CONFIG_SCSI=y
CONFIG_BLK_DEV_SD=y
CONFIG_CHR_DEV_SG=y
CONFIG_SCSI_SCAN_ASYNC=y
CONFIG_NETDEVICES=y
# CONFIG_NET_VENDOR_3COM is not set
# CONFIG_NET_VENDOR_ADAPTEC is not set
# CONFIG_NET_VENDOR_AGERE is not set
# CONFIG_NET_VENDOR_ALTEON is not set
# CONFIG_NET_VENDOR_AMD is not set
# CONFIG_NET_VENDOR_ARC is not set
# CONFIG_NET_VENDOR_ATHEROS is not set
# CONFIG_NET_CADENCE is not set
CONFIG_NET_BCM_AMAC=y
# CONFIG_NET_VENDOR_BROCADE is not set
# CONFIG_NET_VENDOR_CAVIUM is not set
# CONFIG_NET_VENDOR_CHELSIO is not set
# CONFIG_NET_VENDOR_CIRRUS is not set
# CONFIG_NET_VENDOR_CISCO is not set
# CONFIG_NET_VENDOR_DEC is not set
# CONFIG_NET_VENDOR_DLINK is not set
# CONFIG_NET_VENDOR_EMULEX is not set
# CONFIG_NET_VENDOR_EZCHIP is not set
# CONFIG_NET_VENDOR_EXAR is not set
# CONFIG_NET_VENDOR_FARADAY is not set
# CONFIG_NET_VENDOR_HISILICON is not set
# CONFIG_NET_VENDOR_HP is not set
# CONFIG_NET_VENDOR_INTEL is not set
# CONFIG_NET_VENDOR_MARVELL is not set
# CONFIG_NET_VENDOR_MELLANOX is not set
# CONFIG_NET_VENDOR_MICREL is not set
# CONFIG_NET_VENDOR_MYRI is not set
# CONFIG_NET_VENDOR_NATSEMI is not set
# CONFIG_NET_VENDOR_NVIDIA is not set
# CONFIG_NET_VENDOR_OKI is not set
# CONFIG_NET_PACKET_ENGINE is not set
# CONFIG_NET_VENDOR_QLOGIC is not set
# CONFIG_NET_VENDOR_QUALCOMM is not set
# CONFIG_NET_VENDOR_REALTEK is not set
# CONFIG_NET_VENDOR_RENESAS is not set
# CONFIG_NET_VENDOR_RDC is not set
# CONFIG_NET_VENDOR_ROCKER is not set
# CONFIG_NET_VENDOR_SAMSUNG is not set
# CONFIG_NET_VENDOR_SEEQ is not set
# CONFIG_NET_VENDOR_SILAN is not set
# CONFIG_NET_VENDOR_SIS is not set
# CONFIG_NET_VENDOR_SMSC is not set
# CONFIG_NET_VENDOR_STMICRO is not set
# CONFIG_NET_VENDOR_SUN is not set
# CONFIG_NET_VENDOR_SYNOPSYS is not set
# CONFIG_NET_VENDOR_TEHUTI is not set
# CONFIG_NET_VENDOR_TI is not set
# CONFIG_NET_VENDOR_VIA is not set
# CONFIG_NET_VENDOR_WIZNET is not set
CONFIG_PHYLIB=y
CONFIG_BCM_CYGNUS_PHY=y
CONFIG_MDIO_BCM_IPROC=y
# CONFIG_USB_NET_DRIVERS is not set
CONFIG_BRCMFMAC=m
CONFIG_BRCMFMAC_PCIE=y
# CONFIG_RTL_CARDS is not set
CONFIG_INPUT_FF_MEMLESS=y
CONFIG_INPUT_JOYDEV=y
CONFIG_INPUT_EVDEV=y
# CONFIG_KEYBOARD_ATKBD is not set
# CONFIG_KEYBOARD_BCM is not set
# CONFIG_INPUT_MOUSE is not set
CONFIG_INPUT_TOUCHSCREEN=y
CONFIG_INPUT_MISC=y
CONFIG_INPUT_UINPUT=y
# CONFIG_SERIO is not set
# CONFIG_LEGACY_PTYS is not set
CONFIG_SERIAL_8250=y
CONFIG_SERIAL_8250_CONSOLE=y
CONFIG_SERIAL_8250_EXTENDED=y
CONFIG_SERIAL_8250_MANY_PORTS=y
CONFIG_SERIAL_8250_SHARE_IRQ=y
CONFIG_SERIAL_8250_RSA=y
CONFIG_SERIAL_8250_DW=y
CONFIG_HW_RANDOM=y
CONFIG_I2C=y
CONFIG_I2C_CHARDEV=y
CONFIG_GPIO_SYSFS=y
# CONFIG_HWMON is not set
CONFIG_WATCHDOG=y
CONFIG_ARM_SP805_WATCHDOG=y
CONFIG_BCMA=m
CONFIG_MFD_BCM590XX=y
CONFIG_MFD_SYSCON=y
CONFIG_REGULATOR=y
CONFIG_REGULATOR_FIXED_VOLTAGE=y
CONFIG_REGULATOR_USERSPACE_CONSUMER=y
CONFIG_REGULATOR_BCM590XX=y
CONFIG_FB=y
CONFIG_BACKLIGHT_LCD_SUPPORT=y
CONFIG_LCD_CLASS_DEVICE=y
CONFIG_BACKLIGHT_CLASS_DEVICE=y
CONFIG_SOUND=y
CONFIG_SND=y
# CONFIG_SND_DRIVERS is not set
# CONFIG_SND_ARM is not set
# CONFIG_SND_USB is not set
CONFIG_SND_SOC=y
CONFIG_SND_SOC_CYGNUS=y
# CONFIG_SND_SOC_CYGNUS_SVK_MACHINE is not set
CONFIG_USB=y
CONFIG_USB_EHCI_HCD=y
CONFIG_USB_EHCI_ROOT_HUB_TT=y
CONFIG_USB_EHCI_HCD_PLATFORM=y
CONFIG_USB_STORAGE=y
CONFIG_NEW_LEDS=y
CONFIG_LEDS_CLASS=y
CONFIG_LEDS_PCA9532=m
CONFIG_LEDS_TRIGGERS=y
CONFIG_LEDS_TRIGGER_TIMER=y
CONFIG_LEDS_TRIGGER_HEARTBEAT=y
CONFIG_LEDS_TRIGGER_DEFAULT_ON=y
CONFIG_RTC_CLASS=y
CONFIG_DMADEVICES=y
CONFIG_PL330_DMA=y
CONFIG_EXTCON=y
# CONFIG_PHY_IPROC_MDIO is not set
CONFIG_EXT4_FS=y
CONFIG_EXT4_FS_POSIX_ACL=y
CONFIG_EXT4_FS_SECURITY=y
CONFIG_AUTOFS4_FS=y
CONFIG_FUSE_FS=y
CONFIG_MSDOS_FS=y
CONFIG_VFAT_FS=y
CONFIG_TMPFS=y
CONFIG_TMPFS_POSIX_ACL=y
CONFIG_CONFIGFS_FS=y
CONFIG_UBIFS_FS=y
CONFIG_NFS_FS=y
CONFIG_NFS_V4=y
CONFIG_NFS_V4_1=y
CONFIG_ROOT_NFS=y
CONFIG_NLS_CODEPAGE_437=y
CONFIG_NLS_ISO8859_1=y
CONFIG_PRINTK_TIME=y
CONFIG_DEBUG_INFO=y
CONFIG_DEBUG_FS=y
CONFIG_MAGIC_SYSRQ=y
CONFIG_DETECT_HUNG_TASK=y
CONFIG_DEFAULT_HUNG_TASK_TIMEOUT=110
CONFIG_BOOTPARAM_HUNG_TASK_PANIC=y
# CONFIG_FTRACE is not set
CONFIG_DEBUG_LL=y
CONFIG_EARLY_PRINTK=y
CONFIG_CRYPTO_CCM=y
CONFIG_CRYPTO_GCM=y
CONFIG_CRYPTO_ARC4=y
CONFIG_CRC_CCITT=y
CONFIG_CRC_T10DIF=y
CONFIG_CRC_ITU_T=y
CONFIG_CRC7=y
CONFIG_CORDIC=m
```

## arch/arm/mach-bcm/bcm_cygnus_pm/Kconfig
```kconfig
config BCM_CYGNUS_PM
	bool "IPROC PM support"
	depends on ARCH_BCM_CYGNUS
	depends on PM
	default n
	help
	  iProc SoCs power managemet support.
	  If unsure, say N.
```

## drivers/net/ethernet/broadcom/amac/Kconfig
```kconfig
#
# Broadcom AMAC Network configuration
#

config NET_BCM_AMAC
	tristate "Broadcom AMAC Gigabit Ethernet support"
	depends on MDIO_BCM_IPROC && BCM_CYGNUS_PHY
	default n
	---help---
	  This driver supports the on-chip AMAC Ethernet device of the Cygnus chip.
	  The driver uses the BCM_CYGNUS_PHY driver for the Ethernet PHY. It also
	  performs the on-chip SF2 Switch initialization. The driver also supports the
	  switch by-pass mode which is configurable using the device tree.

	  To compile this driver as a module, choose M here. If unsure, say N.
```

## sound/soc/bcm/Kconfig
```kconfig
config SND_BCM2835_SOC_I2S
	tristate "SoC Audio support for the Broadcom BCM2835 I2S module"
	depends on ARCH_BCM2835 || COMPILE_TEST
	select SND_SOC_GENERIC_DMAENGINE_PCM
	select REGMAP_MMIO
	help
	  Say Y or M if you want to add support for codecs attached to
	  the BCM2835 I2S interface. You will also need
	  to select the audio interfaces to support below.

config SND_SOC_CYGNUS
	tristate "SoC platform audio for Broadcom Cygnus chips"
	depends on ARCH_BCM_CYGNUS || COMPILE_TEST
	help
	  Say Y if you want to add support for ASoC audio on Broadcom
	  Cygnus chips (bcm958300, bcm958305, bcm911360)

	  If you don't know what to do here, say N.

config SND_SOC_CYGNUS_SVK_MACHINE
	tristate "SoC Audio support for Broadcom Cygnus SVK development boards"
	depends on SND_SOC_CYGNUS
	default ARCH_BCM_CYGNUS
	select SND_SOC_TLV320AIC3X
#	select SND_SOC_WM8750
	help
	  Say Y if you want to add support for Cygnus SVK development boards.
	  There are SVKs for the bcm911360k, bcm958300k, and the bcm958305k

config SND_SOC_CYGNUS_HOKA_MACHINE
	tristate "SoC Audio support for Broadcom Cygnus hoka boards"
	depends on SND_SOC_CYGNUS
	default ARCH_BCM_CYGNUS
	select SND_SOC_TLV320AIC3X
	help
	  Say Y if you want to add support for Cygnus audio on hoka boards.
	  
```
